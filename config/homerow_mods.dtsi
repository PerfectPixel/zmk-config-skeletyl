/*
 * Homerow mods (Urob "timeless" pattern).
 *
 *   0  1  2  3  4 |  5  6  7  8  9
 *  10 11 12 13 14 | 15 16 17 18 19
 *  20 21 22 23 24 | 25 26 27 28 29
 *           30 31 32 | 33 34 35
 *
 * Left mods on A R S T (10 11 12 13) trigger only when paired with right-hand keys.
 * Right mods on N E I O (16 17 18 19) trigger only when paired with left-hand keys.
 * Thumbs are included on both sides so chord-with-thumb shortcuts work.
 */

#define KEYS_L 0 1 2 3 4 10 11 12 13 14 20 21 22 23 24
#define KEYS_R 5 6 7 8 9 15 16 17 18 19 25 26 27 28 29
#define THUMBS 30 31 32 33 34 35

/ {
    behaviors {
        hml: homerow_mod_left {
            compatible = "zmk,behavior-hold-tap";
            #binding-cells = <2>;
            flavor = "balanced";
            tapping-term-ms = <280>;
            quick-tap-ms = <175>;
            require-prior-idle-ms = <150>;
            bindings = <&kp>, <&kp>;
            hold-trigger-key-positions = <KEYS_R THUMBS>;
            hold-trigger-on-release;
        };

        hmr: homerow_mod_right {
            compatible = "zmk,behavior-hold-tap";
            #binding-cells = <2>;
            flavor = "balanced";
            tapping-term-ms = <280>;
            quick-tap-ms = <175>;
            require-prior-idle-ms = <150>;
            bindings = <&kp>, <&kp>;
            hold-trigger-key-positions = <KEYS_L THUMBS>;
            hold-trigger-on-release;
        };
    };
};
